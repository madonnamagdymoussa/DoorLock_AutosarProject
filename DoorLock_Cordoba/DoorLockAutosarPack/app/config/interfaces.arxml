AUTOSAR XML (schema 00046)
package /Interfaces
  sender receiver interface IF_SR_DoorLock
    data DoorState: type=myuint8
  client server interface IF_CS_LED
    operation Led_Switch: possible-error=[E_ok, E_Not_ok]
      arg LedState: type=myuint8, direction=IN
    error E_ok: error-code=0
    error E_Not_ok: error-code=1
