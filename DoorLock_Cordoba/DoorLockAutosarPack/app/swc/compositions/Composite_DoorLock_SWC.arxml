AUTOSAR XML (schema 00046)
package /Composite_DoorLock_SWC_package
  composition sw component type Composite_DoorLock_SWC
    component DoorSensorAbstractionSWC: type=DoorSensorAbstractionSWC
    component DoorLock_indication_SWC: type=DoorLock_indication_SWC
